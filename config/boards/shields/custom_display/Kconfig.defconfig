## config/boards/shields/custom_display/Kconfig.defconfig
```kconfig
if SHIELD_CUSTOM_DISPLAY

config ZMK_DISPLAY
    default y

config LV_USE_LABEL
    default y

config LV_USE_IMG
    default y

config LV_FONT_MONTSERRAT_12
    default y

config LV_FONT_MONTSERRAT_20
    default y

# Disable default ZMK widgets
config ZMK_WIDGET_LAYER_STATUS
    default n

config ZMK_WIDGET_BATTERY_STATUS
    default n

config ZMK_WIDGET_OUTPUT_STATUS
    default n

config ZMK_WIDGET_WPM_STATUS
    default n

endif
```

## config/boards/shields/custom_display/Kconfig.shield
```kconfig
config SHIELD_CUSTOM_DISPLAY
    def_bool $(shields_list_contains,custom_display)
```
